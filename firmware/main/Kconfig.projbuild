## firmware/main/Kconfig.projbuild
```kconfig
menu "AskNEU"

config ASKNEU_WIFI_SSID
    string "Seed Wi-Fi SSID (first boot only)"
    default ""
    help
        Used once to join a network on a fresh board, then saved like any
        network set from the phone. Hold the screen for 5 s at boot to forget
        it and go back to setup mode.

config ASKNEU_WIFI_PASSWORD
    string "Seed Wi-Fi password (first boot only)"
    default ""

config ASKNEU_API_BASE_URL
    string "Backend base URL"
    default "https://ask-neu.vercel.app"
    help
        Origin only, no trailing slash. The firmware appends /api/ask.
        Point this at http://<lan-ip>:3000 when running the backend locally.

config ASKNEU_DEVICE_TOKEN
    string "Device token (X-Device-Token)"
    default ""
    help
        Shared secret the backend checks on every kiosk request. Set it in
        sdkconfig (gitignored), never in sdkconfig.defaults.

endmenu
```

## firmware/sdkconfig.defaults
```kconfig
# ESP32-S3-BOX-3: 16 MB flash, 16 MB octal PSRAM
CONFIG_ESPTOOLPY_FLASHSIZE_16MB=y
CONFIG_SPIRAM=y
CONFIG_SPIRAM_MODE_OCT=y
CONFIG_SPIRAM_SPEED_80M=y
CONFIG_MBEDTLS_CERTIFICATE_BUNDLE=y
CONFIG_MBEDTLS_CERTIFICATE_BUNDLE_DEFAULT_FULL=y

CONFIG_ESP_MAIN_TASK_STACK_SIZE=8192
CONFIG_LV_FONT_MONTSERRAT_48=y
CONFIG_LV_FONT_MONTSERRAT_20=y
CONFIG_PARTITION_TABLE_CUSTOM=y
CONFIG_PARTITION_TABLE_CUSTOM_FILENAME="partitions.csv"
```
